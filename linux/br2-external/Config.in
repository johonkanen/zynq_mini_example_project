## linux/br2-external/Config.in
```kconfig
source "$BR2_EXTERNAL_ZYNQMINI_PATH/package/fpgad/Config.in"
source "$BR2_EXTERNAL_ZYNQMINI_PATH/package/fpga-web/Config.in"
```

## linux/br2-external/package/fpga-web/Config.in
```kconfig
config BR2_PACKAGE_FPGA_WEB
	bool "fpga-web"
	depends on BR2_TOOLCHAIN_HAS_THREADS
	depends on BR2_USE_MMU
	select BR2_PACKAGE_FPGAD
	select BR2_PACKAGE_CIVETWEB
	select BR2_PACKAGE_CIVETWEB_LIB
	help
	  Web UI on port 80: register read/write and live register plots
	  (uPlot, binary WebSocket stream). Talks only to fpgad; never
	  maps the FPGA itself. Turns on civetweb's WebSocket support.
```

## linux/br2-external/package/fpga-webstream/Config.in
```kconfig
config BR2_PACKAGE_FPGA_WEBSTREAM
	bool "fpga-webstream"
	depends on BR2_TOOLCHAIN_HAS_THREADS
	depends on BR2_USE_MMU
	select BR2_PACKAGE_CIVETWEB
	select BR2_PACKAGE_CIVETWEB_LIB
	help
	  Web page on port 80 that streams live data from the PL
	  (axi_regs over UIO) to the browser with Server-Sent Events.
```

## linux/br2-external/package/fpgad/Config.in
```kconfig
config BR2_PACKAGE_FPGAD
	bool "fpgad"
	depends on BR2_TOOLCHAIN_HAS_THREADS
	help
	  The one process that touches the FPGA: owns the axi_regs window
	  (via UIO) and the FPGA manager, and serves register read/write,
	  streaming and PL reload to other processes over a UNIX socket
	  (/var/run/fpgad.sock). Also installs fpgactl (CLI client) and,
	  in staging, libfpgad-client.a + fpgad_client.h for new clients.
```
